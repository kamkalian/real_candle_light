#include <Adafruit_NeoPixel.h>

// Which pin on the Arduino is connected to the NeoPixels?
#define LED_PIN     1

// How many NeoPixels are attached to the Arduino?
#define LED_COUNT  2

// NeoPixel brightness, 0 (min) to 255 (max)
#define BRIGHTNESS 250

// Halloweenmode: set true and the LED will alternate warm white and green color
#define halloweenmode true

// Recorded values from real candle; count=2000
const int PROGMEM real_candle_values[] = {0,5,10,15,20,25,30,35,40,45,50,55,60,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5,0};

// Position shows on the next index in real_candle_values and will increase in loop()
int pos = 0;

// Trigger for halloweenmode
bool green_on = false;

// Declare our NeoPixel strip object:
Adafruit_NeoPixel strip(LED_COUNT, LED_PIN, NEO_GRBW + NEO_KHZ800);


void setup() {
  strip.begin();           // INITIALIZE NeoPixel strip object (REQUIRED)
  strip.show();            // Turn OFF all pixels ASAP
  strip.setBrightness(BRIGHTNESS); // Set BRIGHTNESS 
}

void loop() {
  int value = pgm_read_word_near(real_candle_values + pos);
  for(int i=0; i<LED_COUNT; i++){
    if(!green_on){
      strip.setPixelColor(i, strip.Color(value, value/4, 0, value/20)); // color for orange-yellow candle
    }else{
      strip.setPixelColor(i, strip.Color(0, value, 0, value/20)); // color for green candle
    }
  }
  strip.show();
  delay(10); // Adds a delay between pulse sets
  pos++;

  if(pos>1999) {
    pos=0;
    if(halloweenmode&&!green_on){
      green_on=true;
    }else{
      green_on=false;
    }
    if(halloweenmode) delay(3000);
  }
    
}
